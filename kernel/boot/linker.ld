/* kernel/boot/linker.ld */

ENTRY(stage2_entry)   /* Точка входа — функция в Rust */

SECTIONS
{
    /* Загрузить весь код и данные по адресу 0x100000 (1 МБ) — обычно место загрузки ядра */
    . = 0x100000;

    /* Секция кода */
    .text :
    {
        *(.multiboot)      /* Multiboot заголовок */
        *(.text*)          /* Код */
        *(.rodata*)        /* Только для чтения данные */
    }

    /* Секция инициализированных данных */
    .data : AT(ADDR(.text) + SIZEOF(.text))
    {
        *(.data*)
    }

    /* Секция неинициализированных данных (BSS) */
    .bss :
    {
        __bss_start = .;
        *(.bss*)
        __bss_end = .;
    }

    /* Стек (например, 16 КБ) */
    .stack (NOLOAD) :
    {
        __stack_start = .;
        . = . + 16K;
        __stack_end = .;
    }

    /* Дополнительно можно определить секции для драйверов, устройств и т.п. */

    /DISCARD/ :
    {
        *(.comment)       /* Удаляем комментарии компилятора */
        *(.eh_frame)
    }
}
